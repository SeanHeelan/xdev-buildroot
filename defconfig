## defconfig
```kconfig
BR2_x86_64=y
BR2_x86_x86_64_v3=y
BR2_PACKAGE_GLIBC_UTILS=y
BR2_CCACHE=y
BR2_OPTIMIZE_2=y
BR2_TARGET_GENERIC_HOSTNAME="vigrid"
BR2_TARGET_GENERIC_ISSUE="\\\\\\\\ Vigrid the plain is called ... ////"
BR2_ROOTFS_DEVICE_CREATION_DYNAMIC_MDEV=y
BR2_ROOTFS_USERS_TABLES="users_table"
BR2_ROOTFS_OVERLAY="overlay"
BR2_PACKAGE_PYTHON3=y
BR2_TARGET_ROOTFS_CPIO=y
BR2_TARGET_ROOTFS_CPIO_GZIP=y
BR2_TARGET_ROOTFS_EXT2=y
BR2_TARGET_ROOTFS_EXT2_4=y
BR2_TARGET_ROOTFS_EXT2_SIZE="100M"
```
